## conf/layer.conf
```bitbake
# We have a conf and classes directory, add to BBPATH
BBPATH .= ":${LAYERDIR}"

# We have a packages directory, add to BBFILES
BBFILES += "${LAYERDIR}/recipes-*/*/*.bb \
            ${LAYERDIR}/recipes-*/*/*.bbappend"

BBFILE_COLLECTIONS += "meta-myir"
BBFILE_PATTERN_meta-myir := "^${LAYERDIR}/"
BBFILE_PRIORITY_meta-myir = "8"
LAYERSERIES_COMPAT_meta-myir = "dunfell gatesgarth"
HOSTTOOLS_NONFATAL_append = " whoami sha384sum xxd realpath"
BBMASK_qoriq += "/meta-imx/meta-bsp/recipes-core"
BBMASK_qoriq += "/meta-imx/meta-bsp/recipes-devtools"
IMAGE_CLASSES_remove = "image_types_create_sdcard_symlink"


# Add the Freescale-specific licenses into the metadata
LICENSE_PATH += "${LAYERDIR}/custom-licenses"

FSL_EULA_FILE = "${LAYERDIR}/EULA"

IMX_MIRROR ?= "https://www.nxp.com/lgfiles/NMG/MAD/YOCTO/"

# FIXME: set this to avoid changing all the recipes that use it
FSL_MIRROR ?= "${IMX_MIRROR}"

MIRRORS += " \
${IMX_MIRROR}   http://download.ossystems.com.br/bsp/freescale/source/ \n \
"

BBFILES_DYNAMIC += " \
    aglprofilegraphical:${LAYERDIR}/dynamic-layers/aglprofilegraphical/*/*/*.bb \
    aglprofilegraphical:${LAYERDIR}/dynamic-layers/aglprofilegraphical/*/*/*.bbappend \
    \
    browser-layer:${LAYERDIR}/dynamic-layers/browser-layer/*/*/*.bb \
    browser-layer:${LAYERDIR}/dynamic-layers/browser-layer/*/*/*.bbappend \
    \
    filesystem-layer:${LAYERDIR}/dynamic-layers/filesystem-layer/*/*/*.bb \
    filesystem-layer:${LAYERDIR}/dynamic-layers/filesystem-layer/*/*/*.bbappend \
    \
    ivi:${LAYERDIR}/dynamic-layers/ivi/*/*/*.bb \
    ivi:${LAYERDIR}/dynamic-layers/ivi/*/*/*.bbappend \
    \
    networking-layer:${LAYERDIR}/dynamic-layers/networking-layer/*/*/*.bb \
    networking-layer:${LAYERDIR}/dynamic-layers/networking-layer/*/*/*.bbappend \
    \
    openembedded-layer:${LAYERDIR}/dynamic-layers/openembedded-layer/*/*/*.bb \
    openembedded-layer:${LAYERDIR}/dynamic-layers/openembedded-layer/*/*/*.bbappend \
    \
    qt4-layer:${LAYERDIR}/dynamic-layers/qt4-layer/*/*/*.bb \
    qt4-layer:${LAYERDIR}/dynamic-layers/qt4-layer/*/*/*.bbappend \
    \
    qt5-layer:${LAYERDIR}/dynamic-layers/qt5-layer/*/*/*.bb \
    qt5-layer:${LAYERDIR}/dynamic-layers/qt5-layer/*/*/*.bbappend \
    \
    virtualization-layer:${LAYERDIR}/dynamic-layers/virtualization-layer/*/*/*.bb \
    virtualization-layer:${LAYERDIR}/dynamic-layers/virtualization-layer/*/*/*.bbappend \
"
# Define new EULAs and add them to the list defined in meta-freescale.
# See fsl-eula-unpack.bbclass.
FSL_EULA_FILE_MD5SUM_LA_OPT_NXP_SOFTWARE_LICENSE_V13 = "1b4db4b25c3a1e422c0c0ed64feb65d2"
FSL_EULA_FILE_MD5SUM_LA_OPT_NXP_SOFTWARE_LICENSE_V16 = "e9e880185bda059c90c541d40ceca922"
FSL_EULA_FILE_MD5SUM_LA_OPT_NXP_SOFTWARE_LICENSE_V17 = "cf3f9b8d09bc3926b1004ea71f7a248a"
FSL_EULA_FILE_MD5SUM_LA_OPT_NXP_SOFTWARE_LICENSE_V18 = "231e11849a4331fcbb19d7f4aab4a659"
FSL_EULA_FILE_MD5SUM_LA_OPT_NXP_SOFTWARE_LICENSE_V19 = "a632fefd1c359980434f9389833cab3a"

FSL_EULA_FILE_MD5SUMS_append = " \
    ${FSL_EULA_FILE_MD5SUM_LA_OPT_NXP_SOFTWARE_LICENSE_V13} \
    ${FSL_EULA_FILE_MD5SUM_LA_OPT_NXP_SOFTWARE_LICENSE_V16} \
    ${FSL_EULA_FILE_MD5SUM_LA_OPT_NXP_SOFTWARE_LICENSE_V17} \
    ${FSL_EULA_FILE_MD5SUM_LA_OPT_NXP_SOFTWARE_LICENSE_V18} \
    ${FSL_EULA_FILE_MD5SUM_LA_OPT_NXP_SOFTWARE_LICENSE_V19} \
"
```
